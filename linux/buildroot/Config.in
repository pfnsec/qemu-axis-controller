## linux/buildroot/Config.in
```kconfig
source "$BR2_EXTERNAL_AXI_LAB_PATH/package/axi-spike/Config.in"
source "$BR2_EXTERNAL_AXI_LAB_PATH/package/framefx/Config.in"
source "$BR2_EXTERNAL_AXI_LAB_PATH/package/axi-mikro-display/Config.in"
```

## linux/buildroot/configs/framefx_virt_defconfig
```kconfig
BR2_aarch64=y
BR2_TOOLCHAIN_EXTERNAL=y
BR2_TOOLCHAIN_EXTERNAL_BOOTLIN=y
BR2_TOOLCHAIN_EXTERNAL_BOOTLIN_AARCH64_GLIBC_STABLE=y
BR2_DOWNLOAD_FORCE_CHECK_HASHES=y
BR2_REPRODUCIBLE=y
BR2_TARGET_GENERIC_HOSTNAME="axi-cosim-lab"
BR2_TARGET_GENERIC_ISSUE="axi-cosim-lab foundation guest"
# BR2_TARGET_GENERIC_REMOUNT_ROOTFS_RW is not set
BR2_ROOTFS_OVERLAY="$(BR2_EXTERNAL_AXI_LAB_PATH)/overlay"
BR2_LINUX_KERNEL=y
BR2_LINUX_KERNEL_CUSTOM_VERSION=y
BR2_LINUX_KERNEL_CUSTOM_VERSION_VALUE="6.12.109"
BR2_LINUX_KERNEL_USE_CUSTOM_CONFIG=y
BR2_LINUX_KERNEL_CUSTOM_CONFIG_FILE="$(BR2_EXTERNAL_AXI_LAB_PATH)/linux.config"
BR2_LINUX_KERNEL_NEEDS_HOST_OPENSSL=y
BR2_PACKAGE_HOST_DTC=y
BR2_PACKAGE_AXI_SPIKE=y
BR2_PACKAGE_FRAMEFX=y
BR2_TARGET_ROOTFS_CPIO=y
BR2_TARGET_ROOTFS_CPIO_GZIP=y
# BR2_TARGET_ROOTFS_TAR is not set
```

## linux/buildroot/configs/ultra96_mikro_defconfig
```kconfig
BR2_aarch64=y
BR2_TOOLCHAIN_EXTERNAL=y
BR2_TOOLCHAIN_EXTERNAL_BOOTLIN=y
BR2_TOOLCHAIN_EXTERNAL_BOOTLIN_AARCH64_GLIBC_STABLE=y
BR2_DOWNLOAD_FORCE_CHECK_HASHES=y
BR2_REPRODUCIBLE=y
BR2_TARGET_GENERIC_HOSTNAME="axi-ultra96"
BR2_TARGET_GENERIC_ISSUE="axi-cosim-lab Ultra96 V1 mikro bring-up - physical validation required"
BR2_ROOTFS_DEVICE_CREATION_DYNAMIC_MDEV=y
BR2_TARGET_GENERIC_GETTY_PORT="ttyPS0"
BR2_ROOTFS_OVERLAY="$(BR2_EXTERNAL_AXI_LAB_PATH)/../hardware/ultra96-mikro/overlay $(BASE_DIR)/lab-overlay"
BR2_PACKAGE_BUSYBOX_CONFIG_FRAGMENT_FILES="$(BR2_EXTERNAL_AXI_LAB_PATH)/../hardware/ultra96-mikro/busybox.fragment"
BR2_PACKAGE_DROPBEAR=y
BR2_PACKAGE_DROPBEAR_CLIENT=y
# BR2_PACKAGE_DROPBEAR_SMALL is not set
BR2_PACKAGE_AXI_MIKRO_DISPLAY=y
BR2_PACKAGE_WPA_SUPPLICANT=y
BR2_PACKAGE_WPA_SUPPLICANT_NL80211=y
BR2_PACKAGE_WPA_SUPPLICANT_CLI=y
BR2_PACKAGE_WPA_SUPPLICANT_PASSPHRASE=y
BR2_PACKAGE_WPA_SUPPLICANT_DEBUG_SYSLOG=y
BR2_PACKAGE_IW=y
BR2_PACKAGE_OPENSSL=y
BR2_PACKAGE_CA_CERTIFICATES=y
BR2_PACKAGE_LIBCURL=y
BR2_PACKAGE_LIBCURL_CURL=y
BR2_PACKAGE_LIBCURL_OPENSSL=y
# BR2_PACKAGE_LIBCURL_EXTRA_PROTOCOLS_FEATURES is not set
BR2_PACKAGE_E2FSPROGS=y
BR2_ROOTFS_DEVICE_TABLE="system/device_table.txt $(BR2_EXTERNAL_AXI_LAB_PATH)/../hardware/ultra96-mikro/permissions.txt"
BR2_TARGET_ROOTFS_EXT2=y
BR2_TARGET_ROOTFS_EXT2_4=y
BR2_TARGET_ROOTFS_EXT2_SIZE="128M"
BR2_TARGET_ROOTFS_EXT2_MKFS_OPTIONS="-O ^orphan_file,^metadata_csum_seed"
BR2_TARGET_ROOTFS_CPIO=y
BR2_TARGET_ROOTFS_CPIO_GZIP=y
# BR2_TARGET_ROOTFS_TAR is not set
```

## linux/buildroot/package/axi-mikro-display/Config.in
```kconfig
config BR2_PACKAGE_AXI_MIKRO_DISPLAY
	bool "Ultra96 mikro CPU framebuffer demo"
	help
	  CPU reference visualization through the kernel framebuffer interface.
	  Does not load or exercise framefx PL logic, DMA or IRQs.
```

## linux/buildroot/package/axi-spike/Config.in
```kconfig
config BR2_PACKAGE_AXI_SPIKE
	bool "axi-spike concurrency self-test module"
	depends on BR2_LINUX_KERNEL
```

## linux/buildroot/package/framefx/Config.in
```kconfig
config BR2_PACKAGE_FRAMEFX
	bool "framefx driver and image test"
	depends on BR2_LINUX_KERNEL
```
